## Kconfig
```kconfig
#
# For a description of the syntax of this configuration file,
# see doc/kconfig/kconfig-language.txt.
#
mainmenu "myrootfs configuration"

# Magic marker used by build system
config DOT_CONFIG
	bool
	default y

source "system/Kconfig"
source "arch/Kconfig"
source "kernel/Kconfig"
source "lib/Kconfig"
source "packages/Kconfig"
source "user/Kconfig"
```

## arch/arm/Kconfig
```kconfig
choice
	prompt "Select Target Machine"
	default VERSATILE
     	depends on ARM

config VERSATILE
	bool "ARM Versatile-PB"

endchoice

config MACH
	string
	default "versatile" if VERSATILE
     	depends on ARM
```

## arch/um/Kconfig
```kconfig
choice
	prompt "Select Target Machine"
	default UM_MACH
     	depends on UM

config UM_MACH
	bool "User Mode Linux"

endchoice

config MACH
	string
	default "um" if UM_MACH
     	depends on UM
```

## kernel/Kconfig
```kconfig
menu "Kernel"

config LINUX_VERSION
       string "Linux version"
       help
	 Linux kernel version, downloaded from kernel.org, it is
       	 assumed to be a kernel >= 4.0

config LINUX_TESTING
       bool "Enable Linux testing (-rcN) versions"
       default n
       help
         Enable building testing kernels.

config LINUX_RC
       string "Linux -rcN version"
       depends on LINUX_TESTING
       help
	 Give on the form: -rcN, e.g. -rc2

endmenu
```

## lib/Kconfig
```kconfig
menu "Libraries"

config LIBMNL
       bool "libmnl, a minimalistic user-space Netlink library"
       help
	 libmnl is a minimalistic user-space library oriented to Netlink
	 developers. There are a lot of common tasks in parsing, validating,
	 constructing of both the Netlink header and TLVs that are repetitive
	 and easy to get wrong. This library aims to provide simple helpers
	 that allows you to re-use code and to avoid re-inventing the wheel. 
	 
	 https://www.netfilter.org/projects/libmnl/

config LIBPCAP
       bool "libpcap, the standard packet capture library"
       help
         Used by tcpdump and other tools to dissect network packets.
	 
	 http://www.tcpdump.org

config NCURSES
       bool "Ncurses"
       help
	 Programming library for text-based user interfaces. Provides
	 a replacement for the old BSD curses library, but also compat
	 libraries for termcap.
	 
	 http://invisible-island.net/ncurses/ncurses.html

config ZLIB
       bool "Zlib"
       help
	 Zlib is used by some apps
endmenu
```

## packages/Kconfig
```kconfig
menu "Networking packages"

config DROPBEAR
       bool "dropbear - Dropbear SSH daemon, client and scp"
       help
	 Embedded friendly SSH daemon, client, and scp tool.
	 
	 https://matt.ucc.asn.au/dropbear/dropbear.html
       depends on ZLIB

config IPROUTE2
       bool "iproute2 - next generation ifconfig et al"
       help
         iproute2 is a collection of userspace utilities for controlling
         and monitoring various aspects of networking in the Linux
         kernel, including routing, network interfaces, tunnels, traffic
         control, and network-related device drivers.
	 
	 https://wiki.linuxfoundation.org/networking/iproute2

config SMCROUTE
       bool "smcroute - Static Multicast Routing Daemon"
       help
	 Carsten Schill's smcroute daemon, for static-only multicast routes.
	 
	 http://troglobit.com/smcroute.html

endmenu

menu "System packages"

config BUSYBOX
       bool "BusyBox - Your basic embedded swiss army chainsaw"
       help
         BusyBox combines tiny versions of many common UNIX utilities
         into a single small executable. It provides replacements for
         most of the utilities you usually find in GNU fileutils,
         shellutils, etc. The utilities in BusyBox generally have fewer
         options than their full-featured GNU cousins; however, the
         options that are included provide the expected functionality
         and behave very much like their GNU counterparts. BusyBox
         provides a fairly complete environment for any small or
         embedded system.
	 
	 BusyBox has been written with size-optimization and limited
	 resources in mind. It is also extremely modular so you can
	 easily include or exclude commands (or features) at compile
	 time. This makes it easy to customize your embedded systems. To
	 create a working system, just add some device nodes in /dev, a
	 few configuration files in /etc, and a Linux kernel.
	 
	 Use `make packages/busybox-menuconfig` and `-saveconfig` to
	 modify and save your BusyBox configuration in TroglOS.
	 
	 https://busybox.net/

config STRACE
       bool "strace - Trace system calls and signals in an application"
       help
	  Use strace to troubleshoot binaries without having to run them
	  through a debugger.  strace prints system calls and signals
	  your application makes.
	  
	  http://strace.sourceforge.net       

config TCPDUMP
       bool "tcpdump - Monitor network traffic"
       help
	 tcpdump is a packet analyzer that runs from the command line.
	 It allows the user to display TCP/IP and other packets being
	 transmitted or received over a network to which the system is
	 attached.
	 
	 http://www.tcpdump.org

endmenu
```

## system/Kconfig
```kconfig
menu "System"
config SYSTEM_HOSTNAME
	string "System/OS default hostname"
	help
	  Used in /etc/hostname and /etc/hosts
          
	  This defaults to SYSTEM_ID.  However, when myrootfs is used with
	  containers, like LXC, the host sets the hostname of the guest.

config SYSTEM_TMPFS_ON_RW
	bool "Fake writable dirs in /etc, /tmp, /home, /root, and /var"
	default false
	help
	  The SquashFS image is read-only by default.  This setting fakes
	  writable directories using OverlayFS on a tmpfs mounted on /rw
          
          Note: when myrootfs is used with containers, like LXC, you don't
	        want this setting enabled.  Instead, the host should mount
		all directories you need.

config SYSTEM_TMPFS_ON_TMP
	bool "Mount /tmp as a tmpfs"
	default false

config SYSTEM_TMPFS_ON_RUN
	bool "Mount /run as a tmpfs"
	default false

comment "Settings for /etc/os-release, /etc/issue, etc."
config SYSTEM_NAME
	string "System/OS name"
	default "My RootFS"
	help
	  A string identifying the operating system, without a version
	  component, and suitable for presentation to the user. If not
	  set, defaults to "NAME=Linux". Example: "NAME=Fedora" or
	  "NAME="Debian GNU/Linux"".
	  
	  https://www.freedesktop.org/software/systemd/man/os-release.html

config SYSTEM_VERSION
	string "System/OS version"
	default "1.0"
	help
	  A string identifying the operating system version, excluding
	  any OS name information, possibly including a release code
	  name, and suitable for presentation to the user. This field is
	  optional. Example: "VERSION=17" or "VERSION="17 (Beefy
	  Miracle)"".
	  
	  https://www.freedesktop.org/software/systemd/man/os-release.html

config SYSTEM_PRETTY_NAME
	string "System/OS pretty name"
	help
	  A pretty operating system name in a format suitable for
	  presentation to the user. May or may not contain a release
	  code name or OS version of some kind, as suitable. If not set,
	  defaults to "PRETTY_NAME="Linux"". Example:
	  "PRETTY_NAME="Fedora 17 (Beefy Miracle)"".
	  
	  https://www.freedesktop.org/software/systemd/man/os-release.html

config SYSTEM_ID
	string "System/OS ID"
	default "myrootfs"
	help
	  A lower-case string (no spaces or other characters outside of
	  0–9, a–z, ".", "_" and "-") identifying the operating system,
	  excluding any version information and suitable for processing
	  by scripts or usage in generated filenames. If not set,
	  defaults to "ID=linux". Example: "ID=fedora" or "ID=debian".
	  
	  https://www.freedesktop.org/software/systemd/man/os-release.html

config SYSTEM_HOME_URL
	string "Homepage of system/OS"
	default "https://github.com/myrootfs"
	help
	  HOME_URL should refer to the homepage of the operating system,
	  or alternatively some homepage of the specific version of the
	  operating system.
	  
	  https://www.freedesktop.org/software/systemd/man/os-release.html

config SYSTEM_DOC_URL
	string "Homepage of system/OS"
	default "https://github.com/myrootfs/myrootfs/blob/master/README.md"
	help
	  DOCUMENTATION_URL should refer to the main documentation page
	  for this operating system.
	  
	  https://www.freedesktop.org/software/systemd/man/os-release.html

config SYSTEM_SUPPORT_URL
	string "Main support page of system/OS"
	default "https://github.com/myrootfs/mrootfs"
	help
	  SUPPORT_URL should refer to the main support page for the
	  operating system, if there is any. This is primarily intended
	  for operating systems which vendors provide support for.
	  
	  https://www.freedesktop.org/software/systemd/man/os-release.html

config SYSTEM_BUG_REPORT_URL
	string "Main bug reporting page of system/OS"
	default "https://github.com/myrootfs/mrootfs/issues"
	help
	  BUG_REPORT_URL should refer to the main bug reporting page for
	  the operating system, if there is any. This is primarily
	  intended for operating systems that rely on community QA.
	  
	  https://www.freedesktop.org/software/systemd/man/os-release.html

endmenu
```

## system/lxd/Kconfig
```kconfig
config LXD_NAME
	string "Container name"
	default SYSTEM_ID
	help
	  When creating LXD containers, use this name.

config LXD_ALIAS
	string "Image alias"
	default LXD_NAME
	help
	  When importing images to the LXD image store, use this alias.


choice
	prompt "Networking"
	default LXD_NET_BR

config LXD_NET_NONE
	prompt "None"
	help
	  No networking available inside the container.


config LXD_NET_BR
	bool "eth0 bridged to lxdbr0"
	help
	  Use LXD's default, add an interface called eth0 in the guest, and
	  connect it to a bridge called lxdbr0.

endchoice

config LXD_NET
	string
	default "" if LXD_NET_NONE
	default "net-eth0-bridged" if LXD_NET_BR

config LXD_PROFILES
	string "Custom Profiles"
	default "default"
	help
	  Whitespace separated list of extra myrootfs profiles to apply to
	  the container. See system/lxd/profiles for available options. If
	  you create or modify any profile, rememeber to run
	  "make lxd-prepare" to sync the changes to the LXD database.
```
